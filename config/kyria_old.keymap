#include <behaviors.dtsi>
#include <behaviors/num_word.dtsi> // Requires auto-layer module.
#include <dt-bindings/zmk/keys.h>

#include <dt-bindings/zmk/bt.h>
#define _BT_SEL_KEYS_ &bt BT_SEL 0 &bt BT_SEL 1 &bt BT_SEL 2 &bt BT_SEL 3 &bt BT_CLR

#define HOST_OS 2

#include "zmk-helpers/helper.h"
#include "zmk-helpers/key-labels/kyria.h"
#include "zmk-helpers/unicode-chars/greek.dtsi"
#include "zmk-helpers/unicode-chars/german.dtsi"

#define DEF 0
#define SYM 1
#define NAV 2
#define FN 3
#define NUM 4
#define SYS 5
#define MOUSE 6
#define QWERTY 7


#define XXX &none
#define ___ &trans

/* Global defaults */

#define QUICK_TAP_MS 175

&sk {
  release-after-ms = <900>;
  quick-release;
};

&sl { // Allow sticky mods to chord across sticky layers.
  ignore-modifiers;
};

&lt {
  flavor = "balanced";
  tapping-term-ms = <200>;
  quick-tap-ms = <QUICK_TAP_MS>;
};

/* Unicode characters */
ZMK_UNICODE_PAIR(no_ae,      KP_N0, KP_N2, KP_N3, KP_N0,    KP_N0, KP_N1, KP_N9, KP_N8)
ZMK_UNICODE_PAIR(no_oe,      KP_N0, KP_N2, KP_N4, KP_N8,    KP_N0, KP_N2, KP_N1, KP_N6)
ZMK_UNICODE_PAIR(no_aa,      KP_N0, KP_N2, KP_N2, KP_N9,    KP_N0, KP_N1, KP_N9, KP_N7)
ZMK_UNICODE_SINGLE(euro,     KP_N0, KP_N1, KP_N2, KP_N8)


/* Homerow mods */

#define KEYS_L LT0 LT1 LT2 LT3 LT4 LT5 LM0 LM1 LM2 LM3 LM4 LM5 LB0 LB1 LB2 LB3 LB4 LB5
#define KEYS_R RT0 RT1 RT2 RT3 RT4 RT5 RM0 RM1 RM2 RM3 RM4 RM5 RB0 RB1 RB2 RB3 RB4 RB5
#define THUMBS LH4 LH3 LH2 LH1 LH0 RH0 RH1 RH2 RH3 RH4 LF1 LF0 RF0 RF1

#define MAKE_HRM(NAME, HOLD, TAP, TRIGGER_POS)                                 \
  ZMK_HOLD_TAP(NAME, bindings = <HOLD>, <TAP>; flavor = "balanced";            \
               tapping-term-ms = <280>; quick-tap-ms = <QUICK_TAP_MS>;         \
               require-prior-idle-ms = <150>; hold-trigger-on-release;         \
               hold-trigger-key-positions = <TRIGGER_POS>;)

MAKE_HRM(hml, &kp, &kp, KEYS_R THUMBS) // Left-hand HRMs.
MAKE_HRM(hmr, &kp, &kp, KEYS_L THUMBS) // Right-hand HRMs.

// Hack: Make HRM combos tap-only (cf, ZMK issue #544).
#define ZMK_COMBO_8(NAME, TAP, POS, LAYERS, COMBO_MS, IDLE_MS, HOLD, SIDE)     \
  MAKE_HRM(hm_combo_##NAME, &kp, TAP, SIDE THUMBS)                             \
  ZMK_COMBO_6(NAME, &hm_combo_##NAME HOLD 0, POS, LAYERS, COMBO_MS, IDLE_MS)

#include "mouse.dtsi"

/* Nav cluster */

// Trigger tap-action on all interrupts.
#define MT_CORE                                                                \
  flavor = "tap-preferred";                                                    \
  tapping-term-ms = <220>;                                                     \
  quick-tap-ms = <220>;                                                        \
  hold-trigger-key-positions = <0>;

&mt { MT_CORE };

ZMK_HOLD_TAP(mt_home, bindings = <&masked_home>, <&kp>; MT_CORE)
ZMK_HOLD_TAP(mt_end, bindings = <&masked_end>, <&kp>; MT_CORE)

#define NAV_LEFT  &mt_home 0   LEFT  // Tap: left  | Long-tap: start of line.
#define NAV_RIGHT &mt_end 0    RIGHT // Tap: right | Long-tap: end   of line.
#define NAV_UP    &mt LC(HOME) UP    // Tap: up    | Long-tap: start of doc.
#define NAV_DOWN  &mt LC(END)  DOWN  // Tap: down  | Long-tap: end   of doc.
#define NAV_BSPC  &mt LC(BSPC) BSPC  // Tap: bspc  | Long-tap: delete word bwd.
#define NAV_DEL   &mt LC(DEL)  DEL   // Tap: del   | Long-tap: delete word fwd.

// Mask CTRL on left/right hold to avoid accidental jumps to start/end of doc.
#define MASK_MODS(NAME, MODS, BINDING)                                         \
  ZMK_MOD_MORPH(NAME, bindings = <BINDING>, <BINDING>; mods = <MODS>;)

MASK_MODS(masked_home, (MOD_LCTL), &kp HOME)
MASK_MODS(masked_end,  (MOD_LCTL), &kp END)

/* Caps-word & auto-layers */

// Tap: sticky-shift | Shift + tap/ double-tap: caps-word | Hold: shift.
ZMK_MOD_MORPH(smart_shft,
  bindings = <&sk LSHFT>, <&caps_word>;
  mods = <(MOD_LSFT)>;
)
&caps_word { // Mods deactivate caps-word, requires PR #1451. [TODO: rebase]
  /delete-property/ ignore-modifiers;
};

// Tap: num-word | double-tap: sticky num-layer | Hold: num-layer.
#define SMART_NUM &smart_num NUM 0
ZMK_HOLD_TAP(smart_num, bindings = <&mo>, <&num_dance>; flavor = "balanced";
             tapping-term-ms = <200>; quick-tap-ms = <QUICK_TAP_MS>;)
ZMK_TAP_DANCE(num_dance, bindings = <&num_word NUM>, <&sl NUM>;
              tapping-term-ms = <200>;)

// Tap: toggle nav layer | Hold: go to nav layer
ZMK_TAP_DANCE(to_nav, bindings = <&mo NAV>, <&tog NAV>;
    tapping-term-ms = <200>;)

// Smart-mouse, requires tri-state module.
ZMK_TRI_STATE(
    smart_mouse, bindings = <&tog MOUSE>, <&none>, <&tog MOUSE>;
    ignored-key-positions =
        <LT1 LT3 LH0 LH1 RT1 RT2 RT3 RM0 RM1 RM2 RM3 RM4 RB1 RB2 RB3 RH0 RH1>;
    ignored-layers = <MOUSE NAV FN>;)

/* Custom behaviors */

// Alt+Tab swapper, requires tri-state module.
ZMK_TRI_STATE(altswapper, bindings = <&kt LALT>, <&kp TAB>, <&kt LALT>;
              ignored-key-positions = <LT2>;)

ZMK_TRI_STATE(ctrlswapper, bindings = <&kt LCTL>, <&kp TAB>, <&kt LCTL>;
              ignored-key-positions = <LT2>;)

// Define mod-morph with a *single* mod trigger for less repetition.
#define SIMPLE_MORPH(NAME, MOD, BINDING1, BINDING2)                            \
  ZMK_MOD_MORPH(NAME, mods = <(MOD_L##MOD | MOD_R##MOD)>;                      \
                bindings = <BINDING1>, <BINDING2>;)

// Tap: comma | Shift + tap: semicolon | Ctrl + shift + tap: <.
SIMPLE_MORPH(comma_morph, SFT, &kp COMMA, &comma_inner_morph)
SIMPLE_MORPH(comma_inner_morph, CTL, &kp SEMICOLON, &kp LESS_THAN)

// Tap: dot | Shift + tap: colon | Ctrl + shift + tap: >.
SIMPLE_MORPH(dot_morph, SFT, &kp DOT, &dot_inner_morph)
SIMPLE_MORPH(dot_inner_morph, CTL, &kp COLON, &kp GREATER_THAN)

// Tap: qmark | Shift + tap: excl.
SIMPLE_MORPH(qexcl, SFT, &kp QMARK, &kp EXCL)

// Tap: left/right parenthesis | Shft + tap: less-than/greater-than.
SIMPLE_MORPH(lpar_lt, SFT, &kp LPAR, &kp LT)
SIMPLE_MORPH(rpar_gt, SFT, &kp RPAR, &kp GT)

// Tap: space | Shift + tap: dot -> space -> sticky shift | Hold: nav layer.
ZMK_HOLD_TAP(lt_spc, bindings = <&mo>, <&spc_morph>; flavor = "balanced";
             tapping-term-ms = <200>; quick-tap-ms = <QUICK_TAP_MS>;)
SIMPLE_MORPH(spc_morph, SFT, &kp SPACE, &dot_spc)
ZMK_MACRO(dot_spc, bindings = <&kp DOT &kp SPACE &sk LSHFT>; wait-ms = <0>;
          tap-ms = <5>;)

// Tap: backspace | Lshft + tap: delete | Rshft + tap: shift-delete.
ZMK_MOD_MORPH(bs_del, bindings = <&kp BSPC>, <&kp DEL>;
              mods = <(MOD_LSFT|MOD_RSFT)>; keep-mods = <MOD_RSFT>;)

// Tap: copy | double-tap: cut.
ZMK_TAP_DANCE(copy_cut, bindings = <&kp LC(INS)>, <&kp LC(X)>;
              tapping-term-ms = <200>;)

// Windows sleep key
ZMK_BEHAVIOR(win_sleep, macro,
    wait-ms = <500>;
    tap-ms = <50>;
    bindings = <&kp LG(X) &kp U &kp S>;
)

// Misc aliases
#define CANCEL      &kp K_CANCEL             // Cancel caps-word, num-word and smart-mouse
#define DSK_PREV    &hmr RSHFT LG(LC(LEFT))  // Previous desktop
#define DSK_NEXT    &hmr LALT LG(LC(RIGHT))  // Next     desktop
#define PIN_WIN     &kp LG(LC(LS(Q)))        // Pin window across desktops
#define PIN_APP     &kp LG(LC(LS(A)))        // Pin application across desktops
#define DSK_MGR     &kp LA(GRAVE)            // Desktop manager
#define VOL_DOWN    &hmr LCTRL C_VOL_DN

/* Keymap */

ZMK_CONDITIONAL_LAYER(sys, FN NUM, SYS) // FN + NUM --> SYS.

ZMK_BASE_LAYER(base_layer,
//╭─────────────┬─────────────┬─────────────┬─────────────┬─────────────┬─────────────╮                                                             ╭─────────────┬─────────────┬─────────────┬─────────────┬─────────────┬─────────────╮
      &kp ESC        &kp Q         &kp W         &kp F         &kp P         &kp B    ,                                                                  &kp J         &kp L         &kp U         &kp Y       &no_aa         &no_ae    ,
//├─────────────┼─────────────┼─────────────┼─────────────┼─────────────┼─────────────┤                                                             ├─────────────┼─────────────┼─────────────┼─────────────┼─────────────┼─────────────┤
      &kp TAB     &hml LGUI A   &hml LALT R   &hml LCTRL S  &hml LSHFT T     &kp G    ,                                                                  &kp M      &hmr RSHFT N  &hmr LCTRL E  &hmr LALT I   &hmr LGUI O     &no_oe    ,
//├─────────────┼─────────────┼─────────────┼─────────────┼─────────────┼─────────────┼─────────────┬─────────────╮     ╭─────────────┬─────────────┼─────────────┼─────────────┼─────────────┼─────────────┼─────────────┼─────────────┤
     &kp LSHFT       &kp Z         &kp X         &kp C      &lt SYM D        &kp V         &to 0         ___      ,       &to QWERTY     &kp BKSP        &kp K       &lt SYM H    &comma_morph  &dot_morph     &kp MINUS      &kp SQT   ,
//╰─────────────┴─────────────┴─────────────┼─────────────┼─────────────┼─────────────┼─────────────┼─────────────┤     ├─────────────┼─────────────┼─────────────┼─────────────┼─────────────┼─────────────┴─────────────┴─────────────╯
                                                 &kp LGUI      &kp DEL       &kp BKSP     &to_nav      SMART_NUM  ,       &lt FN RET     &spc_morph   &smart_shft    &kp TAB       &kp K_CMENU
//                                          ╰─────────────┴─────────────┴─────────────┴─────────────┴─────────────╯     ╰─────────────┴─────────────┴─────────────┴─────────────┴─────────────╯
)

ZMK_BASE_LAYER(sym_layer,
//╭─────────────┬─────────────┬─────────────┬─────────────┬─────────────┬─────────────╮                                                             ╭─────────────┬─────────────┬─────────────┬─────────────┬─────────────┬─────────────╮
        ___          &kp SQT       &kp LT        &kp GT        &kp DQT     &kp GRAVE  ,                                                                  &kp AMPS     &kp COLN    &kp LBRC        &kp RBRC      &kp PRCT        ___     ,
//├─────────────┼─────────────┼─────────────┼─────────────┼─────────────┼─────────────┤                                                             ├─────────────┼─────────────┼─────────────┼─────────────┼─────────────┼─────────────┤
        ___         &kp EXCL      &kp MINUS     &kp PLUS       &kp EQL      &kp HASH  ,                                                                  &kp PIPE     &kp SEMI    &kp LPAR        &kp RPAR      &kp QMARK       ___     ,
//├─────────────┼─────────────┼─────────────┼─────────────┼─────────────┼─────────────┼─────────────┬─────────────╮     ╭─────────────┬─────────────┼─────────────┼─────────────┼─────────────┼─────────────┼─────────────┼─────────────┤
        ___        &kp CARET      &kp FSLH      &kp ASTRK      &kp BSLH      &kp AT         ___           ___     ,           ___           ___          &kp TILDE    &kp DLLR    &kp LBKT        &kp RBKT       &euro          ___     ,
//╰─────────────┴─────────────┴─────────────┼─────────────┼─────────────┼─────────────┼─────────────┼─────────────┤     ├─────────────┼─────────────┼─────────────┼─────────────┼─────────────┼─────────────┴─────────────┴─────────────╯
                                                  ___           ___           ___           ___           ___     ,           ___           ___           ___           ___           ___
//                                          ╰─────────────┴─────────────┴─────────────┴─────────────┴─────────────╯     ╰─────────────┴─────────────┴─────────────┴─────────────┴─────────────╯
)

ZMK_BASE_LAYER(nav_layer,
//╭─────────────┬─────────────┬─────────────┬─────────────┬─────────────┬─────────────╮                                                             ╭─────────────┬─────────────┬─────────────┬─────────────┬─────────────┬─────────────╮
        ___           ___           ___        &kp LS(TAB)  &altswapper  &ctrlswapper ,                                                                 &kp PG_UP     NAV_BSPC       NAV_UP        NAV_DEL        ___           ___     ,
//├─────────────┼─────────────┼─────────────┼─────────────┼─────────────┼─────────────┤                                                             ├─────────────┼─────────────┼─────────────┼─────────────┼─────────────┼─────────────┤
        ___        &kp LGUI      &kp LALT      &kp LCTRL     &kp LSHFT        ___     ,                                                                 &kp PG_DN     NAV_LEFT      NAV_DOWN      NAV_RIGHT       ___           ___     ,
//├─────────────┼─────────────┼─────────────┼─────────────┼─────────────┼─────────────┼─────────────┬─────────────╮     ╭─────────────┬─────────────┼─────────────┼─────────────┼─────────────┼─────────────┼─────────────┼─────────────┤
        ___           ___           ___           ___           ___           ___           ___           ___     ,           ___           ___         &kp INS        &kp TAB       &kp LT        &kp GT         ___           ___     ,
//╰─────────────┴─────────────┴─────────────┼─────────────┼─────────────┼─────────────┼─────────────┼─────────────┤     ├─────────────┼─────────────┼─────────────┼─────────────┼─────────────┼─────────────┴─────────────┴─────────────╯
                                                  ___           ___           ___           ___           ___     ,           ___         CANCEL          ___           ___           ___
//                                          ╰─────────────┴─────────────┴─────────────┴─────────────┴─────────────╯     ╰─────────────┴─────────────┴─────────────┴─────────────┴─────────────╯
)

ZMK_BASE_LAYER(fn_layer,
//╭─────────────┬─────────────┬─────────────┬─────────────┬─────────────┬─────────────╮                                                             ╭─────────────┬─────────────┬─────────────┬─────────────┬─────────────┬─────────────╮
        ___         &kp F12       &kp F7        &kp F8        &kp F9          ___     ,                                                                    ___       &kp C_PREV    &kp C_VOL_UP  &kp C_NEXT    &win_sleep        ___    ,
//├─────────────┼─────────────┼─────────────┼─────────────┼─────────────┼─────────────┤                                                             ├─────────────┼─────────────┼─────────────┼─────────────┼─────────────┼─────────────┤
        ___      &hml LGUI F11 &hml LALT F4  &hml LCTRL F5 &hml LSHFT F6      ___     ,                                                                    ___        DSK_PREV      VOL_DOWN       DSK_NEXT        ___           ___    ,
//├─────────────┼─────────────┼─────────────┼─────────────┼─────────────┼─────────────┼─────────────┬─────────────╮     ╭─────────────┬─────────────┼─────────────┼─────────────┼─────────────┼─────────────┼─────────────┼─────────────┤
        ___         &kp F10       &kp F1        &kp F2        &kp F3          ___           ___           ___     ,           ___           ___         PIN_APP       PIN_WIN       DSK_MGR          ___           ___           ___    ,
//╰─────────────┴─────────────┴─────────────┼─────────────┼─────────────┼─────────────┼─────────────┼─────────────┤     ├─────────────┼─────────────┼─────────────┼─────────────┼─────────────┼─────────────┴─────────────┴─────────────╯
                                                  ___           ___           ___         &kp C_PP    &kp C_MUTE  ,           ___           ___           ___           ___           ___
//                                          ╰─────────────┴─────────────┴─────────────┴─────────────┴─────────────╯     ╰─────────────┴─────────────┴─────────────┴─────────────┴─────────────╯
)

ZMK_BASE_LAYER(num_layer,
//╭─────────────┬─────────────┬─────────────┬─────────────┬─────────────┬─────────────╮                                                             ╭─────────────┬─────────────┬─────────────┬─────────────┬─────────────┬─────────────╮
        ___           ___           ___           ___           ___           ___     ,                                                                &kp KP_NUM       &kp N7        &kp N8        &kp N9   &kp KP_MULTIPLY &kp KP_DIVIDE ,
//├─────────────┼─────────────┼─────────────┼─────────────┼─────────────┼─────────────┤                                                             ├─────────────┼─────────────┼─────────────┼─────────────┼─────────────┼─────────────┤
        ___           ___           ___           ___           ___           ___     ,                                                             &kp KP_DOT      &hmr RSHFT N4 &hmr RCTRL N5 &hmr RALT N6 &hmr RGUI KP_PLUS &kp KP_MINUS ,
//├─────────────┼─────────────┼─────────────┼─────────────┼─────────────┼─────────────┼─────────────┬─────────────╮     ╭─────────────┬─────────────┼─────────────┼─────────────┼─────────────┼─────────────┼─────────────┼─────────────┤
        ___           ___           ___           ___           ___           ___           ___           ___     ,           ___           ___          &kp N0        &kp N1        &kp N2        &kp N3      &kp EQUAL    &kp KP_ENTER ,
//╰─────────────┴─────────────┴─────────────┼─────────────┼─────────────┼─────────────┼─────────────┼─────────────┤     ├─────────────┼─────────────┼─────────────┼─────────────┼─────────────┼─────────────┴─────────────┴─────────────╯
                                                  ___           ___           ___           ___           ___     ,           ___           ___           ___           ___           ___
//                                          ╰─────────────┴─────────────┴─────────────┴─────────────┴─────────────╯     ╰─────────────┴─────────────┴─────────────┴─────────────┴─────────────╯
)

ZMK_BASE_LAYER(sys_layer,
//╭─────────────┬─────────────┬─────────────┬─────────────┬─────────────┬─────────────╮                                                             ╭─────────────┬─────────────┬─────────────┬─────────────┬─────────────┬─────────────╮
        ___                                  _BT_SEL_KEYS_                            ,                                                                    ___           ___           ___           ___           ___           ___    ,
//├─────────────┼─────────────┼─────────────┼─────────────┼─────────────┼─────────────┤                                                             ├─────────────┼─────────────┼─────────────┼─────────────┼─────────────┼─────────────┤
        ___           ___           ___           ___           ___       &bootloader ,                                                                &bootloader       ___           ___           ___           ___           ___    ,
//├─────────────┼─────────────┼─────────────┼─────────────┼─────────────┼─────────────┼─────────────┬─────────────╮     ╭─────────────┬─────────────┼─────────────┼─────────────┼─────────────┼─────────────┼─────────────┼─────────────┤
        ___           ___           ___           ___           ___       &sys_reset           ___           ___  ,              ___           ___        ___            ___           ___           ___           ___           ___    ,
//╰─────────────┴─────────────┴─────────────┼─────────────┼─────────────┼─────────────┼─────────────┼─────────────┤     ├─────────────┼─────────────┼─────────────┼─────────────┼─────────────┼─────────────┴─────────────┴─────────────╯
                                                  ___           ___           ___           ___           ___     ,           ___           ___           ___           ___           ___
//                                          ╰─────────────┴─────────────┴─────────────┴─────────────┴─────────────╯     ╰─────────────┴─────────────┴─────────────┴─────────────┴─────────────╯
)

ZMK_BASE_LAYER(mouse_layer,
//╭─────────────┬─────────────┬─────────────┬─────────────┬─────────────┬─────────────╮                                                             ╭─────────────┬─────────────┬─────────────┬─────────────┬─────────────┬─────────────╮
        ___           ___           ___           ___           ___           ___     ,                                                                  U_WH_L        U_WH_D        U_MS_U         U_WH_U       U_WH_R          ___
//├─────────────┼─────────────┼─────────────┼─────────────┼─────────────┼─────────────┤                                                             ├─────────────┼─────────────┼─────────────┼─────────────┼─────────────┼─────────────┤
        ___           ___           ___           ___           ___           ___     ,                                                                    ___         U_MS_L        U_MS_D         U_MS_R         ___           ___
//├─────────────┼─────────────┼─────────────┼─────────────┼─────────────┼─────────────┼─────────────┬─────────────╮     ╭─────────────┬─────────────┼─────────────┼─────────────┼─────────────┼─────────────┼─────────────┼─────────────┤
        ___           ___           ___           ___           ___           ___           ___           ___     ,           ___           ___           ___         &mkp MB4      &mkp MCLK      &mkp MB5       ___           ___
//╰─────────────┴─────────────┴─────────────┼─────────────┼─────────────┼─────────────┼─────────────┼─────────────┤     ├─────────────┼─────────────┼─────────────┼─────────────┼─────────────┼─────────────┴─────────────┴─────────────╯
                                                  ___           ___           ___           ___           ___     ,          &mkp LCLK     &mkp RCLK      ___           ___           ___
//                                          ╰─────────────┴─────────────┴─────────────┴─────────────┴─────────────╯     ╰─────────────┴─────────────┴─────────────┴─────────────┴─────────────╯
)


ZMK_BASE_LAYER(qwerty_layer,
//╭─────────────┬─────────────┬─────────────┬─────────────┬─────────────┬─────────────╮                                                             ╭─────────────┬─────────────┬─────────────┬─────────────┬─────────────┬─────────────╮
      &kp ESC        &kp Q         &kp W         &kp E         &kp R         &kp T    ,                                                                   &kp Y         &kp U         &kp I         &kp O         &kp P        &kp LBKT
//├─────────────┼─────────────┼─────────────┼─────────────┼─────────────┼─────────────┤                                                             ├─────────────┼─────────────┼─────────────┼─────────────┼─────────────┼─────────────┤
      &kp TAB        &kp A         &kp S         &kp D         &kp F         &kp G    ,                                                                   &kp H         &kp J         &kp K         &kp L     &kp SEMICOLON    &kp SQT
//├─────────────┼─────────────┼─────────────┼─────────────┼─────────────┼─────────────┼─────────────┬─────────────╮     ╭─────────────┬─────────────┼─────────────┼─────────────┼─────────────┼─────────────┼─────────────┼─────────────┤
       &to 0         &kp Z         &kp X         &kp C         &kp V         &kp B       &kp PG_UP  &kp PAGE_DOWN ,        &kp HOME      &kp END        &kp N         &kp M       &kp COMMA      &kp DOT       &kp FSLH      &kp AT
//╰─────────────┴─────────────┴─────────────┼─────────────┼─────────────┼─────────────┼─────────────┼─────────────┤     ├─────────────┼─────────────┼─────────────┼─────────────┼─────────────┼─────────────┴─────────────┴─────────────╯
                                               &kp LSFT      &kp LCTL       &kp LALT       &kp SPC     &kp ENTER  ,        &kp ENTER     &kp SPC       &kp RALT      &kp RCTL      &kp RSFT
//                                          ╰─────────────┴─────────────┴─────────────┴─────────────┴─────────────╯     ╰─────────────┴─────────────┴─────────────┴─────────────┴─────────────╯
)


/*
ZMK_LAYER(blank,
//╭─────────────┬─────────────┬─────────────┬─────────────┬─────────────┬─────────────╮                                                             ╭─────────────┬─────────────┬─────────────┬─────────────┬─────────────┬─────────────╮
        ___           ___           ___           ___           ___           ___     ,                                                                   ___           ___           ___           ___           ___           ___     ,
//├─────────────┼─────────────┼─────────────┼─────────────┼─────────────┼─────────────┤                                                             ├─────────────┼─────────────┼─────────────┼─────────────┼─────────────┼─────────────┤
        ___           ___           ___           ___           ___           ___     ,                                                                   ___           ___           ___           ___           ___           ___     ,
//├─────────────┼─────────────┼─────────────┼─────────────┼─────────────┼─────────────┼─────────────┬─────────────╮     ╭─────────────┬─────────────┼─────────────┼─────────────┼─────────────┼─────────────┼─────────────┼─────────────┤
        ___           ___           ___           ___           ___           ___           ___           ___     ,           ___           ___           ___           ___           ___           ___           ___           ___     ,
//╰─────────────┴─────────────┴─────────────┼─────────────┼─────────────┼─────────────┼─────────────┼─────────────┤     ├─────────────┼─────────────┼─────────────┼─────────────┼─────────────┼─────────────┴─────────────┴─────────────╯
                                                  ___           ___           ___           ___           ___     ,           ___           ___           ___           ___           ___
//                                          ╰─────────────┴─────────────┴─────────────┴─────────────┴─────────────╯     ╰─────────────┴─────────────┴─────────────┴─────────────┴─────────────╯
)
*/
/* vim: set ft=c tw=174: */
